/*
  GBA_Midi_RP2040_Woz.ino

  Goal: Stable RP2040-first multiboot uploader for a GBA MIDI ROM,
  then USB/DIN MIDI forwarding after the GBA runtime is loaded.

  Attribution:
  - Based on and adapted from the SpritesMods GBA MIDI project by
    Jeroen Domburg / Sprite_tm.
  - Original article: https://spritesmods.com/?art=gbamidi

  License:
  - This adaptation is released under Creative Commons Attribution 2.0
    Generic (CC-BY-2.0). See LICENSE.md.

  Key design choices:
  - Direct GPIO register operations for deterministic edge timing.
  - Cycle-based waits (busy_wait_at_least_cycles) instead of microsecond timers.
  - Same tx/rx bit ordering and handshake flow as original gbaserial.c.
  - Embedded stage1 loader and stage2 gbamidi.gba payload in flash.
  - Stage1 follows tangrs/usb-gba-multiboot's second-stage loader protocol:
    BIOS multiboot first, then SIO normal-mode 32-bit stage2 transfer.
  - USB MIDI and DIN MIDI stay idle until the ROM upload reports success.

 *   RP2040 / Arduino-Pico pin settings:                                   *
 *     - USB MIDI host D+ to 22ohm resistor to GPIO pin 14                 *
 *     - USB MIDI host D- to 22ohm resistor to GPIO pin 15                 * 
 *     - USB MIDI host port requires 5V VBUS power, and two 15k resistors  *
 *     one from D+ to ground, and another from D- to ground.               * 
 *                                                                         *
 *     -IMPORTANT set CPU Speed: "240 MHz (Overclock)"                     *
 *     -NOTE use a ground wire to the usb host thicker than 30awg.         *
 *     -Twist D+ and D-, try to keep them short.                           *
 *     -The 22ohm resistors go near the RP2040.                            *
 *                                                                         *
 *   RP2040 built-in USB works as a USB MIDI device.                       *
 *   RP2040 GPIO14/GPIO15 port works as a USB MIDI host.                   *

  Profile A: GBC / GBAMIDI2 two-stage
  - SC -> GPIO2
  - SI -> GPIO3
  - SD -> GPIO5
  - SO -> GPIO4

  Profile B: GBA (deprecated for GBAMIDI2 stage2 for now)
  - SC -> GPIO2
  - SI -> GPIO3
  - SD -> GPIO5

  - G -> Ground

 3 4
 5 G
 G 2
<--socket, port left (pins toward you)

*/

#include <Arduino.h>
#include <Adafruit_TinyUSB.h>
#include <hardware/gpio.h>
#include <hardware/structs/sio.h>
#include <pico/platform.h>
#include <pico/time.h>

// ---------------- RP2040 pin map (change if needed) ----------------
// GBA signal names are from the GBA side.
constexpr uint8_t PIN_GBA_SC_FIXED = 2;       // GBA SC
constexpr uint8_t PIN_GBA_SI_FIXED = 3;       // GBA SI
constexpr uint8_t PIN_GBA_SO_FIXED = 4;       // GBA SO
constexpr uint8_t PIN_GBA_SD_ALT_STAGE1 = 4;  // Working BIOS multiboot SD path.

constexpr uint8_t PIN_STATUS_LED = 25;  // RP2040 Pico-style onboard LED GPIO

// DIN MIDI is optional. Waveshare RP2040 Zero Serial1 defaults are GPIO0 TX / GPIO1 RX.
constexpr uint8_t PIN_DIN_MIDI_TX = 0;
constexpr uint8_t PIN_DIN_MIDI_RX = 1;
constexpr uint32_t DIN_MIDI_BAUD = 31250;

// ---------------- Upload behavior ----------------
constexpr uint32_t MULTIBOOT_RETRY_MS = 1000;
constexpr uint32_t GBA_WORD_TIMEOUT_US = 20000;
constexpr bool STAGE1_EXEC_DIAGNOSTIC_ONLY = false;
constexpr bool STOP_AFTER_STAGE2_FAILURE = true;

// ---------------- MIDI behavior ----------------
constexpr bool USB_TO_DIN_THRU = true;
constexpr bool DIN_TO_USB_THRU = true;

// Original AVR used (F_CPU / 115200) - 16 because its GPIO/timer code had
// measured AVR-specific overhead. RP2040 direct GPIO uses an accurate cycle
// wait, so do not carry that AVR trim over.
constexpr uint32_t GBA_CHAR_CYCLES = F_CPU / 115200UL;
constexpr uint32_t GBA_NORMAL_MODE_CYCLES = F_CPU / 256000UL;
constexpr uint32_t GBA_NORMAL_MODE_CYCLE_OPTIONS[] = {
  F_CPU / 256000UL,
  F_CPU / 128000UL,
  F_CPU / 64000UL,
  F_CPU / 32000UL,
};
constexpr uint8_t GBA_NORMAL_MODE_CYCLE_OPTION_COUNT = sizeof(GBA_NORMAL_MODE_CYCLE_OPTIONS) / sizeof(GBA_NORMAL_MODE_CYCLE_OPTIONS[0]);
constexpr bool GBA_STAGE2_TIMING_DIAGNOSTIC = false;
constexpr uint8_t GBA_STAGE2_CYCLE_OPTION = 1;  // 128 kHz identified by yellow timing diagnostic.

// ---------------- Embedded ROMs ----------------
const uint8_t gbaStage1LoaderImage[] = {
  0x36, 0x00, 0x00, 0xea, 0x24, 0xff, 0xae, 0x51, 0x69, 0x9a, 0xa2, 0x21,
  0x3d, 0x84, 0x82, 0x0a, 0x84, 0xe4, 0x09, 0xad, 0x11, 0x24, 0x8b, 0x98,
  0xc0, 0x81, 0x7f, 0x21, 0xa3, 0x52, 0xbe, 0x19, 0x93, 0x09, 0xce, 0x20,
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  0xfb, 0xff, 0xff, 0x1a, 0x00, 0x00, 0x9a, 0xe5, 0x1e, 0xff, 0x2f, 0xe1,
};

const uint8_t gbaStage2RuntimeImage[] = {
  0x2e, 0x00, 0x00, 0xea, 0x24, 0xff, 0xae, 0x51, 0x69, 0x9a, 0xa2, 0x21,
  0x3d, 0x84, 0x82, 0x0a, 0x84, 0xe4, 0x09, 0xad, 0x11, 0x24, 0x8b, 0x98,
  0xc0, 0x81, 0x7f, 0x21, 0xa3, 0x52, 0xbe, 0x19, 0x93, 0x09, 0xce, 0x20,
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  0x00, 0x00, 0x00, 0x00,
};
constexpr uint32_t GBA_STAGE1_IMAGE_LEN = sizeof(gbaStage1LoaderImage);
constexpr uint32_t GBA_STAGE2_IMAGE_LEN = sizeof(gbaStage2RuntimeImage);
constexpr uint32_t GBA_STAGE1_SEND_LEN = 14UL * 1024UL;
constexpr uint32_t GBA_STAGE2_MAX_SEND_LEN = (256UL * 1024UL) - 16UL;
constexpr uint32_t GBA_STAGE2_MAGIC = 0xFA57B007UL;
constexpr uint32_t GBA_STAGE2_TIMING_MAGIC_BASE = 0xFA57B000UL;
constexpr uint32_t GBA_STAGE2_PRIME_WORD = 0xFA57B000UL;
constexpr uint32_t GBA_STAGE2_TIMEOUT_MS = 1500;

// ---------------- State ----------------
static uint32_t lastAttemptMs = 0;
static bool gbaRuntimeReady = false;
Adafruit_USBD_MIDI usb_midi;
static uint8_t nextBootAttemptProfile = 0;
static uint8_t gbaPinSC = PIN_GBA_SC_FIXED;
static uint8_t gbaPinSD = PIN_GBA_SD_ALT_STAGE1;
static uint8_t gbaPinSI = PIN_GBA_SI_FIXED;
static uint8_t gbaPinSO = PIN_GBA_SO_FIXED;

struct GbaBootAttemptProfile {
  uint8_t stage1SdPin;
  uint8_t paletteData;
  bool sendHeaderComplete;
};

constexpr GbaBootAttemptProfile GBA_BOOT_ATTEMPT_PROFILES[] = {
  // GPIO4 SD first-stage variants. C1/header-complete can chime without
  // reliably jumping into stage1, so try the tangrs palette byte first.
  {PIN_GBA_SD_ALT_STAGE1, 0x91, true},
  {PIN_GBA_SD_ALT_STAGE1, 0x81, true},
  {PIN_GBA_SD_ALT_STAGE1, 0xC1, true},
};
constexpr uint8_t GBA_BOOT_ATTEMPT_PROFILE_COUNT = sizeof(GBA_BOOT_ATTEMPT_PROFILES) / sizeof(GBA_BOOT_ATTEMPT_PROFILES[0]);

// ---------------- Low-level helpers ----------------
static inline uint32_t pinMask(uint8_t pin) {
  return (1u << pin);
}

static inline void gpioSetHighFast(uint32_t mask) {
  sio_hw->gpio_set = mask;
}

static inline void gpioSetLowFast(uint32_t mask) {
  sio_hw->gpio_clr = mask;
}

static inline void gpioOutEnableFast(uint32_t mask) {
  sio_hw->gpio_oe_set = mask;
}

static inline void gpioOutDisableFast(uint32_t mask) {
  sio_hw->gpio_oe_clr = mask;
}

static inline uint32_t gpioReadAllFast() {
  return sio_hw->gpio_in;
}

static inline void waitCycles(uint32_t cycles) {
  busy_wait_at_least_cycles(cycles);
}

static inline bool timeoutExpired(uint32_t startUs, uint32_t timeoutUs) {
  return static_cast<int32_t>(time_us_32() - startUs) >= static_cast<int32_t>(timeoutUs);
}

void serviceUsbTask() {
  TinyUSBDevice.task();
}

void delayWithUsbTask(uint32_t ms) {
  uint32_t start = millis();
  while ((millis() - start) < ms) {
    serviceUsbTask();
    delay(1);
  }
}

void blinkAttempt() {
  digitalWrite(PIN_STATUS_LED, HIGH);
  delay(20);
  digitalWrite(PIN_STATUS_LED, LOW);
}

void blinkSuccess() {
  for (uint8_t i = 0; i < 3; i++) {
    digitalWrite(PIN_STATUS_LED, HIGH);
    delay(70);
    digitalWrite(PIN_STATUS_LED, LOW);
    delay(70);
  }
}

void selectGbaPins(uint8_t stage1SdPin) {
  // GBC cable profile only: SC=2, SI=3, SD=4.
  pinMode(PIN_GBA_SD_ALT_STAGE1, INPUT);

  gbaPinSC = PIN_GBA_SC_FIXED;
  gbaPinSI = PIN_GBA_SI_FIXED;
  gbaPinSO = PIN_GBA_SO_FIXED;
  gbaPinSD = stage1SdPin;
}

void selectStage2Pins() {
  selectGbaPins(PIN_GBA_SD_ALT_STAGE1);
}

void gbaSerInitPins() {
  pinMode(gbaPinSC, INPUT_PULLUP);
  pinMode(gbaPinSD, INPUT_PULLUP);
  pinMode(gbaPinSO, INPUT_PULLUP);
  pinMode(gbaPinSI, OUTPUT);
  digitalWrite(gbaPinSI, HIGH);
}

uint16_t gbaSerRxWord() {
  const uint32_t scMask = pinMask(gbaPinSC);
  const uint32_t sdMask = pinMask(gbaPinSD);
  const uint32_t siMask = pinMask(gbaPinSI);

  uint16_t ret = 0;
  // SD input with pull-up enabled.
  gpioOutDisableFast(sdMask);
  gpio_pull_up(gbaPinSD);

  waitCycles(GBA_CHAR_CYCLES);

  // Tell GBA we want a word by lowering SI.
  gpioSetLowFast(siMask);

  // Wait for start bit.
  uint32_t startWaitUs = time_us_32();
  do {
    while (gpioReadAllFast() & sdMask) {
      if (timeoutExpired(startWaitUs, GBA_WORD_TIMEOUT_US)) {
        gpioOutEnableFast(scMask);
        gpioSetHighFast(scMask);
        gpioSetHighFast(siMask);
        return 0xFFFF;
      }
    }
    waitCycles(GBA_CHAR_CYCLES / 2);
  } while (gpioReadAllFast() & sdMask);

  waitCycles(GBA_CHAR_CYCLES);  // start bit

  for (uint8_t x = 0; x < 16; x++) {
    ret >>= 1;
    if (gpioReadAllFast() & sdMask) {
      ret |= 0x8000;
    }
    waitCycles(GBA_CHAR_CYCLES);
  }

  waitCycles(GBA_CHAR_CYCLES);  // stop bit

  // Done receiving.
  gpioSetHighFast(siMask);
  gpioOutEnableFast(scMask);
  gpioSetHighFast(scMask);

  return ret;
}

void gbaSerTxWord(uint16_t data) {
  const uint32_t scMask = pinMask(gbaPinSC);
  const uint32_t sdMask = pinMask(gbaPinSD);
  const uint32_t siMask = pinMask(gbaPinSI);

  // SD and SC input with pull-ups.
  gpioOutDisableFast(sdMask);
  gpioOutDisableFast(scMask);
  gpio_pull_up(gbaPinSD);
  gpio_pull_up(gbaPinSC);

  // Tell GBA we're sending.
  gpioSetHighFast(siMask);

  // Wait for SD and SC high.
  uint32_t startWaitUs = time_us_32();
  while ((gpioReadAllFast() & (scMask | sdMask)) != (scMask | sdMask)) {
    waitCycles(GBA_CHAR_CYCLES / 2);
    if (timeoutExpired(startWaitUs, GBA_WORD_TIMEOUT_US)) {
      return;
    }
  }

  // Wait 8 bit-times, then drive SD and SC low.
  waitCycles(GBA_CHAR_CYCLES * 8);
  gpioOutEnableFast(scMask | sdMask);
  gpioSetLowFast(scMask | sdMask);

  waitCycles(GBA_CHAR_CYCLES);  // start bit

  for (uint8_t x = 0; x < 16; x++) {
    if (data & 1U) {
      gpioSetHighFast(sdMask);
    } else {
      gpioSetLowFast(sdMask);
    }
    waitCycles(GBA_CHAR_CYCLES);
    data >>= 1;
  }

  gpioSetHighFast(sdMask);
  waitCycles(GBA_CHAR_CYCLES);  // stop bit
}

uint16_t gbaSerXferWord(uint16_t data) {
  noInterrupts();
  gbaSerTxWord(data);
  uint16_t r = gbaSerRxWord();
  interrupts();
  return r;
}

uint32_t gbaNormalXferWord(uint32_t data, uint32_t cycleDelay = GBA_NORMAL_MODE_CYCLES) {
  const uint32_t scMask = pinMask(gbaPinSC);
  const uint32_t siMask = pinMask(gbaPinSI);
  const uint32_t soMask = pinMask(gbaPinSO);
  uint32_t ret = data;

  noInterrupts();

  gpioOutEnableFast(scMask | siMask);
  gpioOutDisableFast(soMask);
  gpio_pull_up(gbaPinSO);
  gpioSetHighFast(scMask);

  for (uint8_t bit = 0; bit < 32; bit++) {
    gpioSetLowFast(scMask);
    if (ret & 0x80000000UL) {
      gpioSetHighFast(siMask);
    } else {
      gpioSetLowFast(siMask);
    }
    waitCycles(cycleDelay);

    gpioSetHighFast(scMask);
    ret <<= 1;
    if (gpioReadAllFast() & soMask) {
      ret |= 1UL;
    }
    waitCycles(cycleDelay);
  }

  gpioSetHighFast(scMask | siMask);
  interrupts();

  return ret;
}

// ---------------- CRC/encryption (from original) ----------------
static uint32_t gbaEncryptSeed = 0;
static uint32_t gbaCrcVal = 0;
static uint8_t gbaCrcVar1 = 0;
static uint16_t gbaCrcVar8 = 0;

void gbaEncryptSetSeed(uint8_t data) {
  gbaEncryptSeed = (static_cast<uint32_t>(data) << 8) | 0xFFFF00C1UL;
}

void gbaEncryptSetSeed(uint8_t data, uint8_t paletteData) {
  gbaEncryptSeed = (static_cast<uint32_t>(data) << 8) | 0xFFFF0000UL | paletteData;
}

uint32_t gbaEncryptWord(uint32_t data, uint32_t offset) {
  gbaEncryptSeed = (gbaEncryptSeed * 0x6F646573UL) + 1UL;
  uint32_t pos = ~(offset + 0x02000000UL) + 1UL;
  return (data ^ gbaEncryptSeed) ^ (pos ^ 0x6465646FUL);
}

void gbaCrcInit(uint8_t var1, uint16_t var8) {
  gbaCrcVal = 0xFFF8UL;
  gbaCrcVar1 = var1;
  gbaCrcVar8 = var8;
}

void gbaCrcAdd(uint32_t data) {
  for (uint8_t bit = 0; bit < 32; bit++) {
    uint32_t var30 = gbaCrcVal ^ data;
    gbaCrcVal >>= 1;
    data >>= 1;
    if (var30 & 1UL) {
      gbaCrcVal ^= 0x0A517UL;
    }
  }
}

uint16_t gbaCrcFinalize(uint32_t data) {
  uint32_t crctemp = ((((data & 0xFF00UL) + gbaCrcVar8) << 8) | 0xFFFF0000UL) + gbaCrcVar1;
  gbaCrcAdd(crctemp);
  return static_cast<uint16_t>(gbaCrcVal & 0xFFFFUL);
}

uint32_t gbaAppChecksumWord(const uint8_t* rom, uint32_t imageLength) {
  uint32_t sum = 0;
  for (uint32_t pos = 0xE0; pos + 3 < imageLength; pos += 4) {
    uint32_t word = static_cast<uint32_t>(rom[pos + 0]);
    word |= static_cast<uint32_t>(rom[pos + 1]) << 8;
    word |= static_cast<uint32_t>(rom[pos + 2]) << 16;
    word |= static_cast<uint32_t>(rom[pos + 3]) << 24;
    sum += word;
  }
  return 0UL - sum;
}

uint8_t gbaUploadByte(const uint8_t* rom, uint32_t imageLength, uint32_t index, uint32_t checksumWord, bool appendChecksumWord, const GbaBootAttemptProfile* profile, uint8_t profileIndex) {
  if (index < imageLength) {
    return rom[index];
  }
  index -= imageLength;
  if (appendChecksumWord && index < 4) {
    return static_cast<uint8_t>((checksumWord >> (index * 8U)) & 0xFFU);
  }
  return 0xFF;
}

bool gbaSendRom(const uint8_t* rom, uint32_t length, uint32_t sendLength, bool appendChecksumWord, const GbaBootAttemptProfile& profile, uint8_t profileIndex) {
  if (length == 0) {
    return false;
  }

  if (length < 0xC0UL || sendLength < length || sendLength > GBA_STAGE2_MAX_SEND_LEN) {
    return false;
  }

  uint32_t checksumWord = gbaAppChecksumWord(rom, length);
  uint32_t romsize = sendLength & 0xFFFFFFF0UL;

  uint16_t rd = 0;
  uint8_t timeout = 30;
  // Wait for GBA handshake.
  do {
    delay(100);
    rd = gbaSerXferWord(0x6202);
    timeout--;
  } while (rd != 0x7202 && timeout > 0);

  if (rd != 0x7202) {
    return false;
  }

  // Send 0xC0 header bytes (unencrypted)
  gbaSerXferWord(0x6100);
  uint32_t ptr = 0;
  for (uint8_t i = 0; i < 0x60; i++) {
    uint16_t d = static_cast<uint16_t>(gbaUploadByte(rom, length, ptr++, checksumWord, appendChecksumWord, &profile, profileIndex));
    d |= static_cast<uint16_t>(gbaUploadByte(rom, length, ptr++, checksumWord, appendChecksumWord, &profile, profileIndex)) << 8;
    gbaSerXferWord(d);
  }

  // Header complete + seed exchange. The original SpritesMods sender skips
  // 0x6200; tangrs sends it. Try both through the boot profile table.
  if (profile.sendHeaderComplete) {
    gbaSerXferWord(0x6200);
  }
  gbaSerXferWord(0x6202);
  uint16_t paletteCommand = 0x6300U | profile.paletteData;
  gbaSerXferWord(paletteCommand);
  rd = gbaSerXferWord(paletteCommand);
  gbaEncryptSetSeed(static_cast<uint8_t>(rd & 0xFF), profile.paletteData);

  uint8_t var1 = static_cast<uint8_t>(((rd & 0xFF) + 0x20F) & 0xFF);
  uint16_t conf = static_cast<uint16_t>(var1) | 0x6400U;
  gbaSerXferWord(conf);

  // Length + CRC init
  uint16_t len = static_cast<uint16_t>(((romsize - 0xC0UL) >> 2) - 0x34UL);
  uint16_t var8 = gbaSerXferWord(len);
  gbaCrcInit(var1, var8);

  // Send encrypted payload
  for (uint32_t pos = 0xC0; pos < romsize; pos += 4) {
    uint32_t d = static_cast<uint32_t>(gbaUploadByte(rom, length, pos + 0, checksumWord, appendChecksumWord, &profile, profileIndex));
    d |= static_cast<uint32_t>(gbaUploadByte(rom, length, pos + 1, checksumWord, appendChecksumWord, &profile, profileIndex)) << 8;
    d |= static_cast<uint32_t>(gbaUploadByte(rom, length, pos + 2, checksumWord, appendChecksumWord, &profile, profileIndex)) << 16;
    d |= static_cast<uint32_t>(gbaUploadByte(rom, length, pos + 3, checksumWord, appendChecksumWord, &profile, profileIndex)) << 24;

    gbaCrcAdd(d);
    d = gbaEncryptWord(d, pos);

    gbaSerXferWord(static_cast<uint16_t>(d & 0xFFFFUL));
    gbaSerXferWord(static_cast<uint16_t>((d >> 16) & 0xFFFFUL));
  }

  // Finish + CRC exchange
  gbaSerXferWord(0x0065);
  gbaSerXferWord(0x0065);

  timeout = 30;
  while (gbaSerXferWord(0x0065) != 0x0075 && timeout > 0) {
    delay(100);
    timeout--;
  }
  if (timeout == 0) {
    return false;
  }

  uint16_t gbaCrc = gbaSerXferWord(0x0066);
  uint16_t localCrc = gbaCrcFinalize(gbaCrc);
  gbaSerXferWord(localCrc);

  return true;
}

uint32_t gbaStage2SendLength() {
  return (GBA_STAGE2_IMAGE_LEN + 4UL + 15UL) & ~15UL;
}

uint8_t gbaStage2UploadByte(uint32_t index, uint32_t checksumWord) {
  if (index < GBA_STAGE2_IMAGE_LEN) {
    return gbaStage2RuntimeImage[index];
  }
  index -= GBA_STAGE2_IMAGE_LEN;
  if (index < 4) {
    return static_cast<uint8_t>((checksumWord >> (index * 8U)) & 0xFFU);
  }
  return 0xFF;
}

uint32_t gbaStage2UploadWord(uint32_t index, uint32_t checksumWord) {
  uint32_t word = static_cast<uint32_t>(gbaStage2UploadByte(index + 0, checksumWord));
  word |= static_cast<uint32_t>(gbaStage2UploadByte(index + 1, checksumWord)) << 8;
  word |= static_cast<uint32_t>(gbaStage2UploadByte(index + 2, checksumWord)) << 16;
  word |= static_cast<uint32_t>(gbaStage2UploadByte(index + 3, checksumWord)) << 24;
  return word;
}

bool gbaSendStage2Runtime() {
  uint32_t sendLength = gbaStage2SendLength();
  if (sendLength > GBA_STAGE2_MAX_SEND_LEN) {
    return false;
  }

  selectStage2Pins();
  gbaSerInitPins();

  if (GBA_STAGE2_TIMING_DIAGNOSTIC) {
    for (uint8_t option = 0; option < GBA_NORMAL_MODE_CYCLE_OPTION_COUNT; option++) {
      uint32_t timingMagic = GBA_STAGE2_TIMING_MAGIC_BASE | static_cast<uint32_t>(option);
      gbaNormalXferWord(timingMagic, GBA_NORMAL_MODE_CYCLE_OPTIONS[option]);
      delay(1500);
    }
    return true;
  }

  uint32_t cycleDelay = GBA_NORMAL_MODE_CYCLE_OPTIONS[GBA_STAGE2_CYCLE_OPTION];
  // The timing diagnostic showed 128 kHz matched after an initial 256 kHz
  // non-matching transfer. Reproduce that harmless priming sequence before
  // sending the real magic word and payload.
  gbaNormalXferWord(GBA_STAGE2_PRIME_WORD, GBA_NORMAL_MODE_CYCLE_OPTIONS[0]);
  delayWithUsbTask(1500);
  gbaNormalXferWord(GBA_STAGE2_MAGIC, cycleDelay);
  delayMicroseconds(250);

  uint32_t checksumWord = gbaAppChecksumWord(gbaStage2RuntimeImage, GBA_STAGE2_IMAGE_LEN);
  uint32_t sendChecksum = 0;
  uint32_t wordCount = sendLength / 4UL;
  gbaNormalXferWord(wordCount, cycleDelay);

  for (uint32_t pos = 0; pos < sendLength; pos += 4) {
    uint32_t word = gbaStage2UploadWord(pos, checksumWord);
    sendChecksum += word;
    gbaNormalXferWord(word, cycleDelay);
  }

  // Stage1 validates this on the GBA side before jumping to the runtime. The
  // return path is not required for loading and may not be wired/reliable.
  gbaNormalXferWord(sendChecksum, cycleDelay);
  return true;
}

void serviceMultiboot() {
  if (gbaRuntimeReady) {
    return;
  }

  uint32_t now = millis();
  if (lastAttemptMs != 0 && (now - lastAttemptMs) < MULTIBOOT_RETRY_MS) {
    return;
  }
  lastAttemptMs = now;

  blinkAttempt();
  const GbaBootAttemptProfile& profile = GBA_BOOT_ATTEMPT_PROFILES[nextBootAttemptProfile];
  selectGbaPins(profile.stage1SdPin);
  gbaSerInitPins();

  if (gbaSendRom(gbaStage1LoaderImage, GBA_STAGE1_IMAGE_LEN, GBA_STAGE1_SEND_LEN, true, profile, nextBootAttemptProfile)) {
    if (STAGE1_EXEC_DIAGNOSTIC_ONLY) {
      gbaRuntimeReady = true;
      return;
    }

    selectStage2Pins();
    gbaSerInitPins();
    delayWithUsbTask(1000);
    if (gbaSendStage2Runtime()) {
      selectGbaPins(PIN_GBA_SD_ALT_STAGE1);
      gbaSerInitPins();
      blinkSuccess();
      gbaRuntimeReady = true;
      return;
    }

    if (STOP_AFTER_STAGE2_FAILURE) {
      gbaRuntimeReady = true;
      return;
    }
  }

  nextBootAttemptProfile = (nextBootAttemptProfile + 1) % GBA_BOOT_ATTEMPT_PROFILE_COUNT;
}

void forwardMidiByteToGba(uint8_t b) {
  if (!gbaRuntimeReady) {
    return;
  }

  // Spritesmods runtime consumes one MIDI byte in the low byte of a 16-bit link word.
  gbaSerTxWord(static_cast<uint16_t>(b));
}

void serviceUsbMidi() {
  while (usb_midi.available() > 0) {
    int v = usb_midi.read();
    if (v < 0) {
      break;
    }

    uint8_t b = static_cast<uint8_t>(v);
    forwardMidiByteToGba(b);
    if (USB_TO_DIN_THRU) {
      Serial1.write(b);
    }
  }
}

void serviceDinMidi() {
  while (Serial1.available() > 0) {
    uint8_t b = static_cast<uint8_t>(Serial1.read());
    forwardMidiByteToGba(b);
    if (DIN_TO_USB_THRU) {
      usb_midi.write(b);
    }
  }
}

void setup() {
  pinMode(PIN_STATUS_LED, OUTPUT);
  digitalWrite(PIN_STATUS_LED, LOW);

  if (!TinyUSBDevice.isInitialized()) {
    TinyUSBDevice.begin(0);
  }
  TinyUSBDevice.setManufacturerDescriptor("Game Boy Advance");
  TinyUSBDevice.setProductDescriptor("Game Boy Advance");
  usb_midi.setStringDescriptor("Game Boy Advance");
  usb_midi.begin();
  if (TinyUSBDevice.mounted()) {
    TinyUSBDevice.detach();
    delay(10);
    TinyUSBDevice.attach();
  }

  Serial1.setTX(PIN_DIN_MIDI_TX);
  Serial1.setRX(PIN_DIN_MIDI_RX);
  Serial1.begin(DIN_MIDI_BAUD);

  selectStage2Pins();
  gbaSerInitPins();

  // Let GBA fully boot to BIOS logo before first attempt.
  delayWithUsbTask(2000);
}

void loop() {
  serviceUsbTask();

  serviceMultiboot();
  serviceUsbMidi();
  serviceDinMidi();
}
