@ GBAMIDI2 stage1 loader.
@ Based on tangrs/usb-gba-multiboot 2ndstageload/loader.s.
@ Original file is marked public domain.

    .section .text
    .arm
    .global _start

_start:
    b entry

    @ Nintendo Logo Character Data
    .byte 0x24, 0xff, 0xae, 0x51, 0x69, 0x9a
    .byte 0xa2, 0x21, 0x3d, 0x84, 0x82, 0x0a, 0x84, 0xe4, 0x09, 0xad, 0x11
    .byte 0x24, 0x8b, 0x98, 0xc0, 0x81, 0x7f, 0x21, 0xa3, 0x52, 0xbe
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    .byte 0x21, 0xd4, 0xf8, 0x07

    @ Game Title, Game Code
    .byte 0x00,0x00,0x00,0x00,0x00,0x00,0x00,0x00
    .byte 0x00,0x00,0x00,0x00
    .byte 0x00,0x00,0x00,0x00

    @ Maker Code, Fixed Value, Main Unit Code, Device Type
    @ Multiboot loaders set device type bit 7; this is part of the BIOS
    @ header check and changes the complement byte below.
    .byte 0x30,0x31,0x96,0x00,0x80

    @ Unused, Version, Complement Check, Checksum
    .byte 0x00,0x00,0x00,0x00,0x00,0x00,0x00
    .byte 0x00,0x70,0x00,0x00

    .align
rom_header_end:
    b entry

    .rept 0x7
    .word 0
    .endr

entry:
    @ Visual diagnostics: red stripe means stage1 code started after BIOS boot.
    mov r0, #0x04000000
    mov r1, #0x400
    orr r1, r1, #0x3
    strh r1, [r0]
    mov r0, #0x06000000
    mov r1, #0x001f
    mov r2, #1024
entry_red_loop:
    strh r1, [r0], #2
    subs r2, r2, #1
    bne entry_red_loop

    @ Relocate the receive loop to IWRAM so stage2 can overwrite EWRAM.
    adr r0, download_code_begin
    mov r1, #0x03000000
    mov r2, #64
    swi 0x0c0000             @ BIOS CpuFastSet

    ldr r10, io_base         @ REG_SCD0 base: 0x04000120
    ldr r9, magic            @ ready magic: 0xfa57b007

    @ GBATEK: RCNT/SIOCNT must select 32-bit normal mode before SIODATA32.
    mov r0, #0
    strh r0, [r10, #0x14]    @ REG_RCNT = 0, leave GPIO/JOYBUS modes
    mov r0, #0x1000
    strh r0, [r10, #0x8]     @ REG_SIOCNT = 32-bit normal, external clock

    mov pc, #0x03000000

magic:
    .word 0xfa57b007
io_base:
    .word 0x04000120

download_code_begin:
    mov r8, #0x02000000      @ stage2 destination address
    mov r7, #0               @ checksum
    mov r6, #0               @ word count

wait_magic:
    mov r0, r9
    bl xfer
    cmp r0, r9
    beq magic_seen

    @ Blue stripe means a 32-bit normal-mode transfer completed, but the word
    @ received by the GBA was not the magic value.
    mov r0, #0x06000000
    mov r1, #0x7c00
    mov r2, #1024
magic_bad_loop:
    strh r1, [r0], #2
    subs r2, r2, #1
    bne magic_bad_loop
    b wait_magic

magic_seen:
    @ Green: stage2 magic received correctly.
    mov r1, #0x03e0
    mov r0, #0x06000000
    mov r2, #1024
magic_seen_loop:
    strh r1, [r0], #2
    subs r2, r2, #1
    bne magic_seen_loop

download:
    mov r0, #0
    bl xfer
    mov r6, r0

loop:
    mov r0, r8
    bl xfer
    str r0, [r8]

    sub r6, r6, #1
    add r8, r8, #4
    add r7, r7, r0

    cmp r6, #0
    bne loop

    mov r0, r7
    bl xfer
    cmp r0, r7
    bne download_code_begin

    mov pc, #0x02000000

xfer:
    str r0, [r10]

    @ Set SIO start bit in REG_SCCNT_L.
    ldrh r0, [r10, #0x8]
    orr r0, r0, #0x80
    bic r0, r0, #0x8
    strh r0, [r10, #0x8]

wait_startbit:
    ldrh r0, [r10, #0x8]
    and r0, r0, #0x80
    cmp r0, #0
    bne wait_startbit

    ldr r0, [r10]
    bx lr

download_code_end:
